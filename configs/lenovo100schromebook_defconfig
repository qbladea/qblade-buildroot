## configs/lenovo100schromebook_defconfig
```kconfig
# Architecture
BR2_x86_64=y

# Toolchain
BR2_TOOLCHAIN_BUILDROOT_CXX=y
BR2_PIC_PIE=y
BR2_SSP_ALL=y
BR2_RELRO_FULL=y

# Host tools
BR2_PACKAGE_HOST_ZSTD=y

# System
BR2_ROOTFS_MERGED_USR=y
BR2_TARGET_TZ_INFO=y
BR2_SYSTEM_ENABLE_NLS=y
BR2_TARGET_GENERIC_ISSUE="Welcome to Linux"
BR2_TARGET_GENERIC_HOSTNAME="linux"
BR2_ROOTFS_DEVICE_CREATION_DYNAMIC_EUDEV=y

# nls
BR2_PACKAGE_NCURSES_WCHAR=y

# rootfs
BR2_TARGET_ROOTFS_CPIO=y
BR2_TARGET_ROOTFS_INITRAMFS=y
BR2_TARGET_ROOTFS_CPIO_ZSTD=y
BR2_ROOTFS_POST_BUILD_SCRIPT="board/lenovo100schromebook/post-build.sh"


# Linux Kernel
BR2_LINUX_KERNEL=y
BR2_LINUX_KERNEL_GZIP=y
BR2_LINUX_KERNEL_NEEDS_HOST_OPENSSL=y
BR2_LINUX_KERNEL_NEEDS_HOST_LIBELF=y
BR2_LINUX_KERNEL_USE_CUSTOM_CONFIG=y
BR2_LINUX_KERNEL_CUSTOM_CONFIG_FILE="board/lenovo100schromebook/linux.config"

# Basic
BR2_PACKAGE_BUSYBOX_WATCHDOG=y
BR2_SYSTEM_BIN_SH_BASH=y
BR2_PACKAGE_KMOD_TOOLS=y

# Busybox
BR2_PACKAGE_BUSYBOX_SHOW_OTHERS=y
BR2_PACKAGE_BUSYBOX_CONFIG="board/lenovo100schromebook/busybox.config"

# SSL certs
BR2_PACKAGE_CA_CERTIFICATES=y

# Cache manager
BR2_PACKAGE_VMTOUCH=y

# Filesystem
BR2_PACKAGE_BTRFS_PROGS=y
BR2_PACKAGE_DOSFSTOOLS=y
BR2_PACKAGE_DOSFSTOOLS_FATLABEL=y
BR2_PACKAGE_DOSFSTOOLS_FSCK_FAT=y
BR2_PACKAGE_DOSFSTOOLS_MKFS_FAT=y
BR2_PACKAGE_E2FSPROGS=y
BR2_PACKAGE_E2FSPROGS_E4DEFRAG=y
BR2_PACKAGE_E2FSPROGS_RESIZE2FS=y
BR2_PACKAGE_EXFAT=y
BR2_PACKAGE_EXFAT_UTILS=y
BR2_PACKAGE_EXFATPROGS=y
BR2_PACKAGE_F2FS_TOOLS=y
BR2_PACKAGE_NTFS_3G=y
BR2_PACKAGE_NTFS_3G_ENCRYPTED=y
BR2_PACKAGE_NTFS_3G_NTFSPROGS=y

# Hardware Firmware
BR2_PACKAGE_LINUX_FIRMWARE=y
BR2_PACKAGE_LINUX_FIRMWARE_IWLWIFI_7260=y

# Disk crypto
BR2_PACKAGE_CRYPTSETUP=y

# Security
BR2_PACKAGE_LINUX_PAM=y
BR2_PACKAGE_HAVEGED=y
BR2_PACKAGE_ACL=y

# Downloader
BR2_PACKAGE_LIBCURL=y
BR2_PACKAGE_LIBCURL_CURL=y
BR2_PACKAGE_LIBCURL_VERBOSE=y

# linedit
BR2_PACKAGE_LIBEDIT=y
BR2_PACKAGE_READLINE=y

# VPN
BR2_PACKAGE_WIREGUARD_TOOLS=y

# Wireless
BR2_PACKAGE_WIRELESS_REGDB=y
BR2_PACKAGE_WIRELESS_TOOLS=y
BR2_PACKAGE_WPA_SUPPLICANT=y
BR2_PACKAGE_WPA_SUPPLICANT_AP_SUPPORT=y
BR2_PACKAGE_WPA_SUPPLICANT_WIFI_DISPLAY=y
BR2_PACKAGE_WPA_SUPPLICANT_MESH_NETWORKING=y
BR2_PACKAGE_WPA_SUPPLICANT_AUTOSCAN=y
BR2_PACKAGE_WPA_SUPPLICANT_EAP=y
BR2_PACKAGE_WPA_SUPPLICANT_HOTSPOT=y
BR2_PACKAGE_WPA_SUPPLICANT_DEBUG_SYSLOG=y
BR2_PACKAGE_WPA_SUPPLICANT_WPS=y
BR2_PACKAGE_WPA_SUPPLICANT_WPA3=y
BR2_PACKAGE_WPA_SUPPLICANT_CLI=y
BR2_PACKAGE_WPA_SUPPLICANT_WPA_CLIENT_SO=y
BR2_PACKAGE_WPA_SUPPLICANT_PASSPHRASE=y

# Network Manager
BR2_PACKAGE_IPROUTE2=y

# Firewall
BR2_PACKAGE_NFTABLES=y

# ssh
BR2_PACKAGE_OPENSSH=y
BR2_PACKAGE_OPENSSH_SERVER=n

# Terminal multiplexes
BR2_PACKAGE_SCREEN=y
BR2_PACKAGE_TMUX=y

# bootloader
BR2_TARGET_GRUB2=y
BR2_TARGET_GRUB2_X86_64_EFI=y
BR2_TARGET_GRUB2_BUILTIN_MODULES="boot linux ext2 fat btrfs part_msdos part_gpt normal efi_gop luks crypto cryptodisk"

# Terminal
BR2_PACKAGE_KMSCON=y

# libdrm
BR2_PACKAGE_LIBDRM_INTEL=y
```

## configs/raspberrypi0w_security_defconfig
```kconfig
BR2_arm=y
BR2_arm1176jzf_s=y
BR2_ARM_EABIHF=y

# Linux headers same as kernel, a 5.10 series
BR2_PACKAGE_HOST_LINUX_HEADERS_CUSTOM_5_10=y

BR2_TOOLCHAIN_BUILDROOT_CXX=n

BR2_LINUX_KERNEL=y
BR2_LINUX_KERNEL_CUSTOM_TARBALL=y
BR2_LINUX_KERNEL_CUSTOM_TARBALL_LOCATION="$(call github,raspberrypi,linux,967d45b29ca2902f031b867809d72e3b3d623e7a)/linux-967d45b29ca2902f031b867809d72e3b3d623e7a.tar.gz"
BR2_LINUX_KERNEL_USE_CUSTOM_CONFIG=y
BR2_LINUX_KERNEL_CUSTOM_CONFIG_FILE="board/raspberrypi0w_security/linux.config"
BR2_LINUX_KERNEL_DTS_SUPPORT=y
BR2_LINUX_KERNEL_INTREE_DTS_NAME="bcm2708-rpi-zero-w"
BR2_LINUX_KERNEL_NEEDS_HOST_OPENSSL=y

BR2_PACKAGE_RPI_FIRMWARE=y

# Required tools to create the SD image
BR2_PACKAGE_HOST_DOSFSTOOLS=y
BR2_PACKAGE_HOST_GENIMAGE=y
BR2_PACKAGE_HOST_MTOOLS=y

# Required tools to compress initrd and kernel
BR2_PACKAGE_HOST_ZSTD=y

# Filesystem / image
BR2_ROOTFS_POST_BUILD_SCRIPT="board/raspberrypi0w_security/post-build.sh"
BR2_ROOTFS_POST_IMAGE_SCRIPT="board/raspberrypi0w_security/post-image.sh"
BR2_ROOTFS_POST_SCRIPT_ARGS=""

# Hostname
BR2_TARGET_GENERIC_HOSTNAME="security"

# Issue
BR2_TARGET_GENERIC_ISSUE="Welcome to Security Linux"

# Security
BR2_PIC_PIE=y
BR2_SSP_ALL=y
BR2_RELRO_FULL=y

# rootfs
BR2_ROOTFS_MERGED_USR=y

# 多語言支持
BR2_SYSTEM_ENABLE_NLS=y

# timezone
BR2_TARGET_TZ_INFO=y

# File system tools
BR2_PACKAGE_BTRFS_PROGS=y
BR2_PACKAGE_DOSFSTOOLS=y
BR2_PACKAGE_DOSFSTOOLS_FSCK_FAT=y
BR2_PACKAGE_DOSFSTOOLS_MKFS_FAT=y


# 磁盤加密
BR2_PACKAGE_CRYPTSETUP=y

# 隨機數生產
BR2_PACKAGE_HAVEGED=y

# 禁用網絡
BR2_PACKAGE_IFUPDOWN_SCRIPTS=y

# 文本編輯器
BR2_PACKAGE_ED=y

# 使用initramfs存放rootfs
BR2_TARGET_ROOTFS_CPIO=y
BR2_TARGET_ROOTFS_CPIO_ZSTD=y
BR2_TARGET_ROOTFS_INITRAMFS=y
```

## configs/raspberrypi3_64_home_defconfig
```kconfig
BR2_aarch64=y
BR2_cortex_a53=y
BR2_ARM_FPU_VFPV4=y

BR2_TOOLCHAIN_BUILDROOT_CXX=n

# Build flags
BR2_PIC_PIE=y
BR2_SSP_ALL=y
BR2_RELRO_FULL=y


# System
BR2_TARGET_GENERIC_PASSWD_SHA512=y
BR2_ROOTFS_MERGED_USR=y
BR2_TARGET_GENERIC_ISSUE="Welcome to Linux"
BR2_TARGET_GENERIC_HOSTNAME="raspberrypi3b"

# Linux headers same as kernel, a 5.10 series
BR2_PACKAGE_HOST_LINUX_HEADERS_CUSTOM_5_10=y

BR2_LINUX_KERNEL=y
BR2_LINUX_KERNEL_CUSTOM_TARBALL=y
BR2_LINUX_KERNEL_CUSTOM_TARBALL_LOCATION="$(call github,raspberrypi,linux,967d45b29ca2902f031b867809d72e3b3d623e7a)/linux-967d45b29ca2902f031b867809d72e3b3d623e7a.tar.gz"
BR2_LINUX_KERNEL_USE_CUSTOM_CONFIG=y
BR2_LINUX_KERNEL_CUSTOM_CONFIG_FILE="board/raspberrypi3_64_home/linux.config"
BR2_LINUX_KERNEL_INSTALL_TARGET=y

# Build the DTB from the kernel sources
BR2_LINUX_KERNEL_DTS_SUPPORT=y
BR2_LINUX_KERNEL_INTREE_DTS_NAME="broadcom/bcm2710-rpi-3-b broadcom/bcm2710-rpi-3-b-plus broadcom/bcm2837-rpi-3-b"
BR2_LINUX_KERNEL_NEEDS_HOST_OPENSSL=y





# Required tools to create the SD image
BR2_PACKAGE_HOST_DOSFSTOOLS=y
BR2_PACKAGE_HOST_GENIMAGE=y
BR2_PACKAGE_HOST_MTOOLS=y

# Packages
BR2_PACKAGE_BUSYBOX_CONFIG="board/raspberrypi3_64_home/busybox.config"
BR2_PACKAGE_DROPBEAR=y
BR2_PACKAGE_DROPBEAR_DISABLE_REVERSEDNS=y
BR2_PACKAGE_WIREGUARD_TOOLS=y
BR2_PACKAGE_WIRELESS_REGDB=y
BR2_PACKAGE_WIRELESS_TOOLS=y
BR2_PACKAGE_WPA_SUPPLICANT=y
BR2_PACKAGE_TMUX=y
BR2_PACKAGE_SCREEN=y
BR2_PACKAGE_RPI_FIRMWARE=y

# Filesystem / image
BR2_TARGET_ROOTFS_EXT2=y
BR2_TARGET_ROOTFS_EXT2_4=y
BR2_TARGET_ROOTFS_EXT2_SIZE="120M"
BR2_TARGET_ROOTFS_EXT2_MKFS_OPTIONS=""
BR2_ROOTFS_POST_BUILD_SCRIPT="board/raspberrypi3_64_home/post-build.sh"
BR2_ROOTFS_POST_IMAGE_SCRIPT="board/raspberrypi3_64_home/post-image.sh"
BR2_ROOTFS_POST_SCRIPT_ARGS="--aarch64 --add-miniuart-bt-overlay"
BR2_TARGET_ROOTFS_TAR=y
```

## configs/redmi2_defconfig
```kconfig
BR2_arm=y
BR2_cortex_a53=y
BR2_ARM_FPU_NEON_VFPV4=y

BR2_PACKAGE_HOST_LINUX_HEADERS_CUSTOM_3_10=y

BR2_LINUX_KERNEL=y
BR2_LINUX_KERNEL_CUSTOM_TARBALL=y
BR2_LINUX_KERNEL_CUSTOM_TARBALL_LOCATION="$(call github,LineageOS,android_kernel_wingtech_msm8916,beb5692ed25808aebce7b57e318cf8bd33e645d8)/linux-beb5692ed25808aebce7b57e318cf8bd33e645d8.tar.gz"

BR2_LINUX_KERNEL_DEFCONFIG="lineageos_wt88047"

# Build the DTB from the kernel sources
BR2_LINUX_KERNEL_DTS_SUPPORT=y
BR2_LINUX_KERNEL_INTREE_DTS_NAME="msm8916-wt88047"

BR2_LINUX_KERNEL_NEEDS_HOST_OPENSSL=y
```

## configs/wt88047_64_defconfig
```kconfig
BR2_aarch64=y
BR2_ARM_FPU_VFPV4=y

BR2_PIC_PIE=y
BR2_SSP_ALL=y
BR2_RELRO_FULL=y
BR2_KERNEL_HEADERS_5_4=y
BR2_GCC_ENABLE_LTO=y
BR2_TARGET_GENERIC_HOSTNAME="wt88047"
BR2_ROOTFS_DEVICE_CREATION_DYNAMIC_EUDEV=y
BR2_SYSTEM_ENABLE_NLS=y
BR2_TARGET_TZ_INFO=y
BR2_LINUX_KERNEL=y
BR2_LINUX_KERNEL_CUSTOM_GIT=y
BR2_LINUX_KERNEL_CUSTOM_REPO_URL="https://github.com/msm8916-mainline/linux.git"
BR2_LINUX_KERNEL_CUSTOM_REPO_VERSION="master"
BR2_LINUX_KERNEL_USE_CUSTOM_CONFIG=y
BR2_LINUX_KERNEL_CUSTOM_CONFIG_FILE="$(TOPDIR)/board/wt88047-64/linux.config"
BR2_LINUX_KERNEL_INTREE_DTS_NAME="qcom/msm8916-wingtech-wt88047"
BR2_LINUX_KERNEL_NEEDS_HOST_OPENSSL=y
BR2_LINUX_KERNEL_NEEDS_HOST_LIBELF=y
BR2_PACKAGE_BUSYBOX_WATCHDOG=y
BR2_PACKAGE_DROPBEAR=y
BR2_PACKAGE_DROPBEAR_DISABLE_REVERSEDNS=y
BR2_PACKAGE_ED=y
BR2_TARGET_ROOTFS_CPIO=y
BR2_TARGET_ROOTFS_CPIO_ZSTD=y
```
