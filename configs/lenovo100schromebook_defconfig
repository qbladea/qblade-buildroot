## configs/x86_64_luhux_portable_defconfig
```kconfig
# Architecture
BR2_x86_64=y

# Toolchain
BR2_TOOLCHAIN_BUILDROOT_CXX=y
BR2_PIC_PIE=y
BR2_SSP_ALL=y
BR2_RELRO_FULL=y

# System
BR2_ROOTFS_MERGED_USR=y
BR2_TARGET_TZ_INFO=y
BR2_SYSTEM_ENABLE_NLS=y
BR2_TARGET_GENERIC_ISSUE="Welcome to Linux"
BR2_TARGET_GENERIC_HOSTNAME="linux"
BR2_ROOTFS_DEVICE_CREATION_DYNAMIC_EUDEV=y

# nls
BR2_PACKAGE_NCURSES_WCHAR=y
BR2_PACKAGE_PCRE_UCP=y

# rootfs
BR2_TARGET_ROOTFS_CPIO=y
BR2_TARGET_ROOTFS_CPIO_XZ=y
BR2_TARGET_ROOTFS_TAR_XZ=y
BR2_TARGET_ROOTFS_INITRAMFS=y
BR2_ROOTFS_POST_BUILD_SCRIPT="board/x86_64_luhux_portable/post-build.sh"

# Linux Kernel
BR2_LINUX_KERNEL=y
BR2_LINUX_KERNEL_XZ=y
BR2_LINUX_KERNEL_NEEDS_HOST_OPENSSL=y
BR2_LINUX_KERNEL_NEEDS_HOST_LIBELF=y
BR2_LINUX_KERNEL_USE_CUSTOM_CONFIG=y
BR2_LINUX_KERNEL_CUSTOM_CONFIG_FILE="board/luhux-portable/linux.config"

# Basic
BR2_PACKAGE_BUSYBOX_WATCHDOG=y
BR2_SYSTEM_BIN_SH_BASH=y
BR2_PACKAGE_COREUTILS=y
BR2_PACKAGE_KMOD_TOOLS=y
BR2_PACKAGE_PROCPS_NG=y
BR2_PACKAGE_PSMISC=y
BR2_PACKAGE_UTIL_LINUX_BINARIES=y
BR2_PACKAGE_UTIL_LINUX_AGETTY=y
BR2_PACKAGE_UTIL_LINUX_BFS=y
BR2_PACKAGE_UTIL_LINUX_CAL=y
BR2_PACKAGE_UTIL_LINUX_CHFN_CHSH=y
BR2_PACKAGE_UTIL_LINUX_CHMEM=y
BR2_PACKAGE_UTIL_LINUX_CRAMFS=y
BR2_PACKAGE_UTIL_LINUX_EJECT=y
BR2_PACKAGE_UTIL_LINUX_FALLOCATE=y
BR2_PACKAGE_UTIL_LINUX_FDFORMAT=y
BR2_PACKAGE_UTIL_LINUX_FSCK=y
BR2_PACKAGE_UTIL_LINUX_HARDLINK=y
BR2_PACKAGE_UTIL_LINUX_HWCLOCK=y
BR2_PACKAGE_UTIL_LINUX_IPCRM=y
BR2_PACKAGE_UTIL_LINUX_IPCS=y
BR2_PACKAGE_UTIL_LINUX_KILL=y
BR2_PACKAGE_UTIL_LINUX_LAST=y
BR2_PACKAGE_UTIL_LINUX_LINE=y
BR2_PACKAGE_UTIL_LINUX_LOGGER=y
BR2_PACKAGE_UTIL_LINUX_LOSETUP=y
BR2_PACKAGE_UTIL_LINUX_LSLOGINS=y
BR2_PACKAGE_UTIL_LINUX_LSMEM=y
BR2_PACKAGE_UTIL_LINUX_MESG=y
BR2_PACKAGE_UTIL_LINUX_MINIX=y
BR2_PACKAGE_UTIL_LINUX_MORE=y
BR2_PACKAGE_UTIL_LINUX_MOUNT=y
BR2_PACKAGE_UTIL_LINUX_MOUNTPOINT=y
BR2_PACKAGE_UTIL_LINUX_NEWGRP=y
BR2_PACKAGE_UTIL_LINUX_NOLOGIN=y
BR2_PACKAGE_UTIL_LINUX_NSENTER=y
BR2_PACKAGE_UTIL_LINUX_PG=y
BR2_PACKAGE_UTIL_LINUX_PARTX=y
BR2_PACKAGE_UTIL_LINUX_PIVOT_ROOT=y
BR2_PACKAGE_UTIL_LINUX_RAW=y
BR2_PACKAGE_UTIL_LINUX_RENAME=y

BR2_PACKAGE_UTIL_LINUX_SCHEDUTILS=y
BR2_PACKAGE_UTIL_LINUX_SETPRIV=y
BR2_PACKAGE_UTIL_LINUX_SETTERM=y
BR2_PACKAGE_UTIL_LINUX_SULOGIN=y
BR2_PACKAGE_UTIL_LINUX_SWITCH_ROOT=y
BR2_PACKAGE_UTIL_LINUX_TUNELP=y
BR2_PACKAGE_UTIL_LINUX_UL=y
BR2_PACKAGE_UTIL_LINUX_UNSHARE=y
BR2_PACKAGE_UTIL_LINUX_UTMPDUMP=y
BR2_PACKAGE_UTIL_LINUX_UUIDD=y
BR2_PACKAGE_UTIL_LINUX_VIPW=y
BR2_PACKAGE_UTIL_LINUX_WALL=y
BR2_PACKAGE_UTIL_LINUX_WIPEFS=y
BR2_PACKAGE_UTIL_LINUX_WDCTL=y
BR2_PACKAGE_UTIL_LINUX_WRITE=y
BR2_PACKAGE_UTIL_LINUX_ZRAMCTL=y

# Busybox
BR2_PACKAGE_BUSYBOX_SHOW_OTHERS=y

# Media
BR2_PACKAGE_ALSA_UTILS=y
BR2_PACKAGE_MPG123=y

# Compression
BR2_PACKAGE_BZIP2=y
BR2_PACKAGE_XZ=y
BR2_PACKAGE_ZSTD=y
BR2_PACKAGE_LZ4_PROGS=y


# SSL certs
BR2_PACKAGE_CA_CERTIFICATES=y

# Libressl
BR2_PACKAGE_OPENSSL=y
BR2_PACKAGE_LIBRESSL=y
BR2_PACKAGE_LIBRESSL_BIN=y

# Cache manager
BR2_PACKAGE_VMTOUCH=y

# Version Control
BR2_PACKAGE_GIT=y


# Archive
BR2_PACKAGE_CPIO=y
BR2_PACKAGE_TAR=y

# Filesystem
BR2_PACKAGE_BTRFS_PROGS=y
BR2_PACKAGE_CIFS_UTILS=y
BR2_PACKAGE_DOSFSTOOLS=y
BR2_PACKAGE_DOSFSTOOLS_FATLABEL=y
BR2_PACKAGE_DOSFSTOOLS_FSCK_FAT=y
BR2_PACKAGE_DOSFSTOOLS_MKFS_FAT=y
BR2_PACKAGE_E2FSPROGS=y
BR2_PACKAGE_E2FSPROGS_E4DEFRAG=y
BR2_PACKAGE_E2FSPROGS_RESIZE2FS=y
BR2_PACKAGE_ECRYPTFS_UTILS=y
BR2_PACKAGE_EROFS_UTILS=y
BR2_PACKAGE_EROFS_UTILS_LZ4=y
BR2_PACKAGE_EXFAT=y
BR2_PACKAGE_EXFAT_UTILS=y
BR2_PACKAGE_EXFATPROGS=y
BR2_PACKAGE_F2FS_TOOLS=y
BR2_PACKAGE_FLASHBENCH=y
BR2_PACKAGE_NTFS_3G=y
BR2_PACKAGE_NTFS_3G_ENCRYPTED=y
BR2_PACKAGE_NTFS_3G_NTFSPROGS=y
BR2_PACKAGE_SQUASHFS=y
BR2_PACKAGE_SQUASHFS_GZIP=y
BR2_PACKAGE_SQUASHFS_LZ4=y
BR2_PACKAGE_SQUASHFS_LZMA=y
BR2_PACKAGE_SQUASHFS_LZO=y
BR2_PACKAGE_SQUASHFS_XZ=y
BR2_PACKAGE_SQUASHFS_ZSTD=y
BR2_PACKAGE_XFSPROGS=y

# Terminal
BR2_PACKAGE_KMSCON=y

# Font
BR2_PACKAGE_UNIFONT=y

# picture
BR2_PACKAGE_FBV=y

# Hardware Firmware
BR2_PACKAGE_LINUX_FIRMWARE=y

BR2_PACKAGE_LINUX_FIRMWARE_ATHEROS_6002=y
BR2_PACKAGE_LINUX_FIRMWARE_ATHEROS_6003=y
BR2_PACKAGE_LINUX_FIRMWARE_ATHEROS_6004=y
BR2_PACKAGE_LINUX_FIRMWARE_ATHEROS_7010=y
BR2_PACKAGE_LINUX_FIRMWARE_ATHEROS_9170=y
BR2_PACKAGE_LINUX_FIRMWARE_ATHEROS_9271=y
BR2_PACKAGE_LINUX_FIRMWARE_ATHEROS_10K_QCA9377=y
BR2_PACKAGE_LINUX_FIRMWARE_ATHEROS_10K_QCA998X=y
BR2_PACKAGE_LINUX_FIRMWARE_BRCM_BCM43XX=y
BR2_PACKAGE_LINUX_FIRMWARE_BRCM_BCM43XXX=y
BR2_PACKAGE_LINUX_FIRMWARE_BRCM_BCM4366B1=y
BR2_PACKAGE_LINUX_FIRMWARE_BRCM_BCM4366C0=y
BR2_PACKAGE_LINUX_FIRMWARE_IWLWIFI_22260=y
BR2_PACKAGE_LINUX_FIRMWARE_IWLWIFI_3160=y
BR2_PACKAGE_LINUX_FIRMWARE_IWLWIFI_3168=y
BR2_PACKAGE_LINUX_FIRMWARE_IWLWIFI_5000=y
BR2_PACKAGE_LINUX_FIRMWARE_IWLWIFI_6000G2A=y
BR2_PACKAGE_LINUX_FIRMWARE_IWLWIFI_6000G2B=y
BR2_PACKAGE_LINUX_FIRMWARE_IWLWIFI_7260=y
BR2_PACKAGE_LINUX_FIRMWARE_IWLWIFI_7265=y
BR2_PACKAGE_LINUX_FIRMWARE_IWLWIFI_7265D=y
BR2_PACKAGE_LINUX_FIRMWARE_IWLWIFI_8000C=y
BR2_PACKAGE_LINUX_FIRMWARE_IWLWIFI_8265=y
BR2_PACKAGE_LINUX_FIRMWARE_IWLWIFI_9XXX=y
BR2_PACKAGE_LINUX_FIRMWARE_LIBERTAS_SD8686_V8=y
BR2_PACKAGE_LINUX_FIRMWARE_LIBERTAS_SD8686_V9=y
BR2_PACKAGE_LINUX_FIRMWARE_LIBERTAS_SD8688=y
BR2_PACKAGE_LINUX_FIRMWARE_LIBERTAS_USB8388_V9=y
BR2_PACKAGE_LINUX_FIRMWARE_LIBERTAS_USB8388_OLPC=y
BR2_PACKAGE_LINUX_FIRMWARE_LIBERTAS_USB_THINFIRM=y
BR2_PACKAGE_LINUX_FIRMWARE_MWIFIEX_SD8787=y
BR2_PACKAGE_LINUX_FIRMWARE_MWIFIEX_SD8797=y
BR2_PACKAGE_LINUX_FIRMWARE_MWIFIEX_USB8797=y
BR2_PACKAGE_LINUX_FIRMWARE_MWIFIEX_USB8801=y
BR2_PACKAGE_LINUX_FIRMWARE_MWIFIEX_SD8887=y
BR2_PACKAGE_LINUX_FIRMWARE_MWIFIEX_SD8897=y
BR2_PACKAGE_LINUX_FIRMWARE_MWIFIEX_USB8897=y
BR2_PACKAGE_LINUX_FIRMWARE_MWIFIEX_PCIE8897=y
BR2_PACKAGE_LINUX_FIRMWARE_MEDIATEK_MT7601U=y
BR2_PACKAGE_LINUX_FIRMWARE_MEDIATEK_MT7610E=y
BR2_PACKAGE_LINUX_FIRMWARE_MEDIATEK_MT76X2E=y
BR2_PACKAGE_LINUX_FIRMWARE_QUALCOMM_6174=y
BR2_PACKAGE_LINUX_FIRMWARE_RALINK_RT61=y
BR2_PACKAGE_LINUX_FIRMWARE_RALINK_RT73=y
BR2_PACKAGE_LINUX_FIRMWARE_RALINK_RT2XX=y
BR2_PACKAGE_LINUX_FIRMWARE_RTL_81XX=y
BR2_PACKAGE_LINUX_FIRMWARE_RTL_87XX=y
BR2_PACKAGE_LINUX_FIRMWARE_RTL_88XX=y
BR2_PACKAGE_LINUX_FIRMWARE_RTL_RTW88=y
BR2_PACKAGE_LINUX_FIRMWARE_REDPINE_RS9113=y
BR2_PACKAGE_LINUX_FIRMWARE_TI_WL127X=y
BR2_PACKAGE_LINUX_FIRMWARE_TI_WL128X=y
BR2_PACKAGE_LINUX_FIRMWARE_TI_WL18XX=y
BR2_PACKAGE_LINUX_FIRMWARE_QUALCOMM_WIL6210=y
BR2_PACKAGE_LINUX_FIRMWARE_BROADCOM_TIGON3=y
BR2_PACKAGE_LINUX_FIRMWARE_BNX2X=y
BR2_PACKAGE_LINUX_FIRMWARE_CXGB4_T4=y
BR2_PACKAGE_LINUX_FIRMWARE_CXGB4_T5=y
BR2_PACKAGE_LINUX_FIRMWARE_INTEL_E100=y
BR2_PACKAGE_LINUX_FIRMWARE_MICROCHIP_VSC85XX_PHY=y
BR2_PACKAGE_LINUX_FIRMWARE_QLOGIC_4X=y
BR2_PACKAGE_LINUX_FIRMWARE_RTL_8169=y

# ACPI
BR2_PACKAGE_ACPICA=y
BR2_PACKAGE_ACPID=y
BR2_PACKAGE_ACPITOOL=y
BR2_PACKAGE_CRYPTSETUP=y


# Screen Console
BR2_PACKAGE_KBD=y


# Serial
BR2_PACKAGE_PICOCOM=y


# Security
BR2_PACKAGE_WIPE=y
BR2_PACKAGE_LINUX_PAM=y
BR2_PACKAGE_HAVEGED=y
BR2_PACKAGE_ACL=y


# hardware
BR2_PACKAGE_USBUTILS=y
BR2_PACKAGE_PCIUTILS=y


# disk partition
BR2_PACKAGE_PARTED=y


# Downloader
BR2_PACKAGE_LIBCURL=y
BR2_PACKAGE_LIBCURL_CURL=y
BR2_PACKAGE_LIBCURL_VERBOSE=y


# linedit
BR2_PACKAGE_LIBEDIT=y
BR2_PACKAGE_READLINE=y

# Monitor
BR2_PACKAGE_BMON=y
BR2_PACKAGE_HTOP=y

# Time
BR2_PACKAGE_NTP=y
BR2_PACKAGE_NTP_NTPDATE=y

# Tor
BR2_PACKAGE_TOR=y

# Hack
BR2_PACKAGE_WAVEMON=y
BR2_PACKAGE_TCPDUMP=y
BR2_PACKAGE_NMAP=y
BR2_PACKAGE_REAVER=y
BR2_PACKAGE_AIRCRACK_NG=y
# Aircrack-ng need
BR2_PACKAGE_ETHTOOL=y
BR2_PACKAGE_IW=y
BR2_PACKAGE_UTIL_LINUX_RFKILL=y
BR2_PACKAGE_WIRELESS_TOOLS=y

# sync
BR2_PACKAGE_RSYNC=y

# Web browser
BR2_PACKAGE_LINKS=y
BR2_PACKAGE_LYNX=y

# socks5 proxy 
BR2_PACKAGE_PROXYCHAINS_NG=y
BR2_PACKAGE_SHADOWSOCKS_LIBEV=y

# VPN
BR2_PACKAGE_WIREGUARD_TOOLS=y

# Network bandwith test
BR2_PACKAGE_IPERF3=y

# Wireless
BR2_PACKAGE_WIRELESS_REGDB=y
BR2_PACKAGE_WPA_SUPPLICANT=y
BR2_PACKAGE_WPA_SUPPLICANT_AP_SUPPORT=y
BR2_PACKAGE_WPA_SUPPLICANT_WIFI_DISPLAY=y
BR2_PACKAGE_WPA_SUPPLICANT_MESH_NETWORKING=y
BR2_PACKAGE_WPA_SUPPLICANT_AUTOSCAN=y
BR2_PACKAGE_WPA_SUPPLICANT_EAP=y
BR2_PACKAGE_WPA_SUPPLICANT_HOTSPOT=y
BR2_PACKAGE_WPA_SUPPLICANT_DEBUG_SYSLOG=y
BR2_PACKAGE_WPA_SUPPLICANT_WPS=y
BR2_PACKAGE_WPA_SUPPLICANT_WPA3=y
BR2_PACKAGE_WPA_SUPPLICANT_CLI=y
BR2_PACKAGE_WPA_SUPPLICANT_WPA_CLIENT_SO=y
BR2_PACKAGE_WPA_SUPPLICANT_PASSPHRASE=y
BR2_PACKAGE_WPA_SUPPLICANT_DBUS=y
BR2_PACKAGE_WPA_SUPPLICANT_DBUS_INTROSPECTION=y

# Network Manager
BR2_PACKAGE_IPROUTE2=y
BR2_PACKAGE_IPUTILS=y
BR2_PACKAGE_MACCHANGER=y
BR2_PACKAGE_TCPING=y

# Firewall
BR2_PACKAGE_NFTABLES=y


# ssh
BR2_PACKAGE_DROPBEAR=y

# Scan file type
BR2_PACKAGE_FILE=y

# GPG
BR2_PACKAGE_GNUPG2=y
BR2_PACKAGE_GNUPG2_GPGV=y
BR2_PACKAGE_PINENTRY=y

# Terminal multiplexes
BR2_PACKAGE_SCREEN=y
BR2_PACKAGE_TMUX=y


# data recovery
BR2_PACKAGE_DDRESCUE=y

# Password
BR2_PACKAGE_PWGEN=y

# Text Editor
BR2_PACKAGE_ED=y
BR2_PACKAGE_MG=y
BR2_PACKAGE_NANO=y
BR2_PACKAGE_VIM=y

# Pager
BR2_PACKAGE_LESS=y
```

## package/kmscon/Config.in
```kconfig
config BR2_PACKAGE_KMSCON
	bool "kmscon"
	depends on BR2_PACKAGE_HAS_UDEV
	select BR2_PACKAGE_LIBDRM
	select BR2_PACKAGE_LIBTSM
	select BR2_PACKAGE_LIBXKBCOMMON
	help
		Kmscon is a terminal emulator based on Linux's "kernel mode setting" (KMS).
		It can replace the in-kernel virtual terminal (VT) implementation with a
		user-space console.  Compared to the Linux console,
		kmscon provides enhanced features
		including XKB-compatible internationalized keyboard support,
		UTF-8 input/font support, hardware-accelerated rendering,
		multi-seat support, a replacement for `mingetty', and more
```

## package/libtsm/Config.in
```kconfig
menuconfig BR2_PACKAGE_LIBTSM
	bool "libtsm"
	help
		TSM is a state machine for DEC VT100-VT520 compatible terminal emulators.
		It tries to support all common standards while keeping compatibility to
		existing + emulators like xterm, gnome-terminal, konsole, etc.
```

## package/unifont/Config.in
```kconfig
config BR2_PACKAGE_UNIFONT
	bool "unifont"
	help
		GNU Unifont is a bitmap font covering essentially all of
		Unicode's Basic Multilingual Plane
		The package also includes utilities
		to ease adding new glyphs to the font.
```
